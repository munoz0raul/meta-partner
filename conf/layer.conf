## conf/layer.conf
```bitbake
# We might have a conf and classes directory, append to BBPATH
BBPATH .= ":${LAYERDIR}"

# We have a recipes directory, add to BBFILES
BBFILES += "${LAYERDIR}/recipes*/*/*.bb ${LAYERDIR}/recipes*/*/*.bbappend"

BBFILE_COLLECTIONS += "meta-partner-qualcomm"
BBFILE_PATTERN_meta-partner-qualcomm := "^${LAYERDIR}/"
BBFILE_PRIORITY_meta-partner-qualcomm = "9"

LAYERDEPENDS_meta-partner-qualcomm = "meta-lmp-base"
LAYERSERIES_COMPAT_meta-partner-qualcomm = "kirkstone"

INHERIT += "lmp-qcom-fixups"

# Adjust priority for meta-qcom-hwe layer (too high by default)
BBFILE_PRIORITY_qcom-hwe:remove = "10"
BBFILE_PRIORITY_qcom-hwe:append = " 6"
```
